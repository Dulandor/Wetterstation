// Code generated by senseBox Blockly on Fri May 30 2025 15:35:11 GMT+0200 (Mitteleuropäische Sommerzeit)

#include <senseBoxIO.h>
#include <SPI.h>
#include <Wire.h>
#include <Adafruit_GFX.h> // http://librarymanager/All#Adafruit_GFX_Library
#include <Adafruit_SSD1306.h> // http://librarymanager/All#Adafruit_SSD1306
#include <WiFi101.h>
#include <WebUtil.h>
#include <Adafruit_HDC1000.h> // http://librarymanager/All#Adafruit_HDC1000_Library
#include <Adafruit_DPS310.h> // http://librarymanager/All#Adafruit_DPS310
#include <LTR329.h>
#include <VEML6070.h>

char ssid[] = "SSID";
char pass[] = "Password";
int status = WL_IDLE_STATUS;

#define SCREEN_WIDTH 128
#define SCREEN_HEIGHT 64
#define OLED_RESET -1
Adafruit_SSD1306 display(SCREEN_WIDTH, SCREEN_HEIGHT, &Wire, OLED_RESET);
const char SENSOR_IDRID[] PROGMEM = "sensorID";
Adafruit_HDC1000 hdc = Adafruit_HDC1000();
Adafruit_DPS310 dps;

bool lightsensortype = 0; //0 for tsl - 1 for ltr
//settings for LTR sensor
LTR329 LTR;
unsigned char gain = 1;
unsigned char integrationTime = 0;
unsigned char measurementRate = 3;

VEML6070 veml;

WiFiServer server(80);

int read_reg(byte address, uint8_t reg)
{
  int i = 0;
  Wire.beginTransmission(address);
  Wire.write(reg);
  Wire.endTransmission();
  Wire.requestFrom((uint8_t)address, (uint8_t)1);
  delay(1);
  if(Wire.available())
  i = Wire.read();
  return i;
}

void write_reg(byte address, uint8_t reg, uint8_t val)
{
  Wire.beginTransmission(address);
  Wire.write(reg);
  Wire.write(val);
  Wire.endTransmission();
}

void Lightsensor_begin()
{
  unsigned int u = 0;
  u = read_reg(0x29, 0x80 | 0x0A); //id register
  if ((u & 0xF0) == 0xA0)            // TSL45315
  {
    write_reg(0x29, 0x80 | 0x00, 0x03); //control: power on
    write_reg(0x29, 0x80 | 0x01, 0x02); //config: M=4 T=100ms
    delay(120);
    lightsensortype = 0; //TSL45315
  }
  else
  {
    LTR.begin();
    LTR.setControl(gain, false, false);
    LTR.setMeasurementRate(integrationTime, measurementRate);
    LTR.setPowerUp(); //power on with default settings
    delay(10); //Wait 10 ms (max) - wakeup time from standby
    lightsensortype = 1;                     //
  }
}

uint32_t Lightsensor_getIlluminance()
{
  unsigned int lux = 0;
  if (lightsensortype == 0) // TSL45315
  {
    unsigned int u = (read_reg(0x29, 0x80 | 0x04) << 0);  //data low
    u |= (read_reg(0x29, 0x80 | 0x05) << 8); //data high
    lux = u * 4; // calc lux with M=4 and T=100ms
  }
  else if (lightsensortype == 1) //LTR-329ALS-01
  {
    delay(100);
    unsigned int data0, data1;
    for (int i = 0; i < 5; i++) {
      if (LTR.getData(data0, data1)) {
        if(LTR.getLux(gain, integrationTime, data0, data1, lux));
        if(lux > 0) break;
        else delay(10);
      }
      else {
        byte error = LTR.getError();
      }
    }
  }
  return lux;
}

void setup() {
  Wire.begin();

  display.begin(SSD1306_SWITCHCAPVCC, 0x3D);
  display.display();
  delay(100);
  display.clearDisplay();

  if (WiFi.status() == WL_NO_SHIELD) {
    while (true);
  }
  while (status != WL_CONNECTED) {
    status = WiFi.begin(ssid, pass);
    delay(5000);
  }

  server.begin();
  Data = SD.open("Data.txt", FILE_WRITE);
  Data.println("Keine Eingabe");
  addMeasurement(SENSOR_IDRID,"Keine Eingabe");
  Data.close();

  hdc.begin();
  dps.begin_I2C(0x76);

  dps.configurePressure(DPS310_64HZ, DPS310_64SAMPLES);
  dps.configureTemperature(DPS310_64HZ, DPS310_64SAMPLES);

  Lightsensor_begin();
  veml.begin();

}

void loop() {
  sensors_event_t temp_event, pressure_event;
  dps.getEvents(&temp_event, &pressure_event);
  WiFiClient client = server.available();
  if (client && client.available()) {
    String request_string = listenClient(client);
    Request request;
    if (parseRequestSafe(request_string, request)) {
    }
    delay(1);
    client.stop();
    delay(1);
  }
  display.setCursor(0,0);
  display.setTextSize(1);
  display.setTextColor(WHITE,BLACK);
  display.println((String("Temperature: ") + String(hdc.readTemperature())));
  display.setCursor(0,10);
  display.setTextSize(1);
  display.setTextColor(WHITE,BLACK);
  display.println((String("Humidity: ") + String(hdc.readHumidity())));
  display.setCursor(0,20);
  display.setTextSize(1);
  display.setTextColor(WHITE,BLACK);
  display.println((String("Pressure: ") + String(pressure_event.pressure)));
  display.setCursor(0,30);
  display.setTextSize(1);
  display.setTextColor(WHITE,BLACK);
  display.println((String("Height: ") + String(dps.readAltitude(1013))));
  display.setCursor(0,30);
  display.setTextSize(1);
  display.setTextColor(WHITE,BLACK);
  display.println((String("Light: ") + String(Lightsensor_getIlluminance())));
  display.setCursor(0,30);
  display.setTextSize(1);
  display.setTextColor(WHITE,BLACK);
  display.println((String("Light: ") + String(veml.getUV())));
  display.setCursor(0,40);
  display.setTextSize(1);
  display.setTextColor(WHITE,BLACK);
  display.println((String("Height: ") + String(b->getIpAddress())));
  display.display();

}